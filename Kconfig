## Kconfig
```kconfig
menu "AWS IoT Library Configurations"

    config AWS_IOT_USE_NETWORK_TRANSPORT_PORT
        bool "Use included network transport port."
        default y
        help
            The coreMQTT and coreHTTP libraries require users to define the NetworkContext struct along with a Transport Receive and 
            Transport Send function that consume the defined NetworkContext struct. Enabling this setting pulls in an implementation
            that works with ESP-IDF, while leaving this disabled requires the user implement the NetworkContext struct and Transport
            Receive and Transport Send functions themselves.

    menu "coreMQTT"

        config MQTT_STATE_ARRAY_MAX_COUNT
            int "Max Incoming/Outgoing Publish Messages Pending ACK"
            default 10
            range 0 4294967295
            help
                Determines the maximum number of MQTT PUBLISH messages, pending
                acknowledgment at a time, that are supported for incoming and outgoing
                direction of messages, separately.

                QoS 1 and 2 MQTT PUBLISHes require acknowledgment from the server before
                they can be completed. While they are awaiting the acknowledgment, the
                client must maintain information about their state. The value of this
                macro sets the limit on how many simultaneous PUBLISH states an MQTT
                context maintains, separately, for both incoming and outgoing direction of
                PUBLISHes.

                The MQTT context maintains separate state records for outgoing
                and incoming PUBLISHes, and thus, 2 * MQTT_STATE_ARRAY_MAX_COUNT amount
                of memory is statically allocated for the state records.

        config MQTT_MAX_CONNACK_RECEIVE_RETRY_COUNT
            int "Max CONNACK Retries"
            default 5
            range 0 65535
            help
                The number of retries for receiving CONNACK.

                The MQTT_MAX_CONNACK_RECEIVE_RETRY_COUNT will be used only when the
                timeoutMs parameter of #MQTT_Connect is passed as 0 . The transport
                receive for CONNACK will be retried MQTT_MAX_CONNACK_RECEIVE_RETRY_COUNT
                times before timing out. A value of 0 for this config will cause the
                transport receive for CONNACK  to be invoked only once.

        config MQTT_PINGRESP_TIMEOUT_MS
            int "Ping Response Timeout Milliseconds"
            default 5000
            help
                This can be any positive integer up to SIZE_MAX.

                Maximum number of milliseconds to wait for a ping response to a ping
                request as part of the keep-alive mechanism.
                
                If a ping response is not received before this timeout, then
                MQTT_ProcessLoop function will return MQTTKeepAliveTimeout.
                
                If this value is more than half of the keep alive interval, and the
                server does not receive the previous ping request, then it is likely that the
                server will disconnect the client before #MQTTKeepAliveTimeout can be returned.
                
                If a dummy implementation of the MQTTGetCurrentTimeFunc_t timer function,
                is supplied to the library, then the keep-alive mechanism is not supported by the
                MQTT_ProcessLoop API function. In that case, the value of MQTT_PINGRESP_TIMEOUT_MS
                is irrelevant to the behavior of the library.

        config MQTT_RECV_POLLING_TIMEOUT_MS
            int "MQTT Packet Receive Polling Timeout"
            default 10
            range 0 4294967295
            help
                The maximum duration between non-empty network reads while
                receiving an MQTT packet via the MQTT_ProcessLoop or MQTT_ReceiveLoop
                API functions.
                
                When an incoming MQTT packet is detected, the transport receive function
                may be called multiple times until all of the expected number of bytes of the
                packet are received. This timeout represents the maximum polling duration that
                is allowed without any data reception from the network for the incoming packet.
                
                If the timeout expires, the MQTT_ProcessLoop and MQTT_ReceiveLoop functions
                return MQTTRecvFailed.
                
                If a dummy implementation of the MQTTGetCurrentTimeFunc_t timer function,
                is supplied to the library, then MQTT_RECV_POLLING_TIMEOUT_MS MUST be set to 0.

        config MQTT_SEND_RETRY_TIMEOUT_MS
            int "MQTT Send Retry Timeout Milliseconds"
            default 10
            range 0 4294967295
            help
                The maximum duration between non-empty network transmissions while
                sending an MQTT packet via the MQTT_ProcessLoop or #MQTT_ReceiveLoop
                API functions.
            
                When sending an MQTT packet, the transport send function may be called multiple
                times until all of the required number of bytes are sent.
                This timeout represents the maximum duration that is allowed for no data
                transmission over the network through the transport send function.
            
                If the timeout expires, the MQTT_ProcessLoop and #MQTT_ReceiveLoop functions
                return #MQTTSendFailed.
            
                If a dummy implementation of the MQTTGetCurrentTimeFunc_t timer function,
                is supplied to the library, then MQTT_SEND_RETRY_TIMEOUT_MS MUST be set to 0.

        menu "Logging"

            config CORE_MQTT_LOG_ERROR
                bool "Enable Error Logging"
                default n
            
            config CORE_MQTT_LOG_WARN
                bool "Enable Warning Logging"
                default n

            config CORE_MQTT_LOG_INFO
                bool "Enable Info Logging"
                default y

            config CORE_MQTT_LOG_DEBUG
                bool "Enable Debug Logging"
                default n

        endmenu # coreMQTT Logging

    endmenu # coreMQTT

    menu "coreMQTT-Agent"
    
        config MQTT_AGENT_MAX_OUTSTANDING_ACKS
            int "Max Pending ACKS Per Connection"
            default 10
            help
                This can be set to any positive integer up to SIZE_MAX.
                The maximum number of pending acknowledgments to track for a single connection.
                The MQTT agent tracks MQTT commands (such as PUBLISH and SUBSCRIBE) that are still 
                waiting to be acknowledged. MQTT_AGENT_MAX_OUTSTANDING_ACKS set the maximum number 
                of acknowledgments that can be outstanding at any one time. The higher this number 
                is the greater the agent's RAM consumption will be.

        config MQTT_AGENT_MAX_EVENT_QUEUE_WAIT_TIME
            int "Max Event Queue Wait Time Milliseconds"
            default 1000
            range 0 4294967295
            help
                Time in milliseconds that the MQTT agent task will wait in the Blocked state 
                (so not using any CPU time) for a command to arrive in its command queue before 
                exiting the blocked state so it can call MQTT_ProcessLoop().
                It is important that MQTT_ProcessLoop() is called often if there is known MQTT 
                traffic, but calling it too often can take processing time away from lower priority 
                tasks and waste CPU time and power.

    endmenu # coreMQTT-Agent

    menu "Device Defender"

    endmenu # Device Defender

    menu "Device Shadow"

    endmenu # Device Shadow

    menu "AWS OTA"

        config AWS_OTA_LOG2_FILE_BLOCK_SIZE
            int "Log base 2 of the size of the file data block message (excluding the header)."
            default 12

        config AWS_OTA_SELF_TEST_RESPONSE_WAIT_MS
            int "Self Test Response Wait Time Milliseconds"
            default 16000
            help
                Milliseconds to wait for the self test phase to succeed before we force reset.

        config AWS_OTA_FILE_REQUEST_WAIT_MS
            int "File Request Wait Time Milliseconds"
            default 10000
            help
                Milliseconds to wait before requesting data blocks from the OTA service
                if nothing is happening.            
                The wait timer is reset whenever a data block is received from the OTA
                service so we will only send the request message after being idle for this
                amount of time.

        config AWS_OTA_MAX_THINGNAME_LEN
            int "Max Thingname Length"
            default 128
            help
                The maximum allowed length of the thing name used by the OTA agent.
                AWS IoT requires Thing names to be unique for each device that connects to the
                broker. Likewise, the OTA agent requires the developer to construct and pass
                in the Thing name when initializing the OTA agent. The agent uses this size to
                allocate static storage for the Thing name used in all OTA base topics.
                Namely $aws/things/<thingName>

        config AWS_OTA_MAX_NUM_BLOCKS_REQUEST
            int "Max Number of Blocks Per Request"
            default 1
            help 
                The maximum number of data blocks requested from OTA streaming service.         
                This configuration parameter is sent with data requests and represents the
                maximum number of data blocks the service will send in response. The maximum
                limit for this must be calculated from the maximum data response limit (128 KB
                from service) divided by the block size. For example if block size is set as 1
                KB then the maximum number of data blocks that we can request is
                128/1 = 128 blocks. Configure this parameter to this maximum limit or lower
                based on how many data blocks response is expected for each data requests.
                Note: This must be set larger than zero.

        config AWS_OTA_MAX_NUM_REQUEST_MOMENTUM
            int "Max Number of Requests before Abort"
            default 32
            help
                The maximum number of requests allowed to send without a response before
                we abort.
                This configuration parameter sets the maximum number of times the requests are
                made over the selected communication channel before aborting and returning error.

        config AWS_OTA_OTA_UPDATE_STATUS_FREQUENCY
            int "Update Status Frequency"
            default 25
            help
                How frequently the device will report its OTA progress to the cloud.
                Device will update the job status with the number of blocks it has received every certain
                number of blocks it receives. For example, 25 means device will update job status every 25 blocks
                it receives.

        config AWS_OTA_ALLOW_DOWNGRADE
            bool "Allow Downgrade"
            default n
            help
                Allow update to same or lower version.
                Set this to 1 to allow downgrade or same version update.This configurations parameter
                disables version check and allows update to a same or lower version.This is provided for
                testing purpose and it is recommended to always update to higher version and keep this
                configuration disabled.

        menu "Control Protocol"

            config AWS_OTA_ENABLED_CONTROL_PROTOCOL_MQTT
            bool "MQTT"
            default y
            help
                The protocol selected for OTA control operations.           
                This configurations parameter sets the default protocol for all the OTA control
                operations like requesting OTA job, updating the job status etc.            
                Note: Only MQTT is supported at this time for control operations.

        endmenu # Control Protocol

        menu "Enabled Data Protocols"

            config AWS_OTA_ENABLED_DATA_PROTOCOL_HTTP
                bool "HTTP"
                default n

            config AWS_OTA_ENABLED_DATA_PROTOCOL_MQTT
                bool "MQTT"
                default y

        endmenu # Enabled Data Protocols

        choice "Primary Data Protocol"

            prompt "Select Primary Data Protocol"

            config AWS_OTA_OTA_PRIMARY_DATA_PROTOCOL_MQTT
                bool "MQTT"

            config AWS_OTA_OTA_PRIMARY_DATA_PROTOCOL_HTTP
                bool "HTTP"

        endchoice # Primary Data Protocol

        menu "Logging"

            config AWS_OTA_LOG_ERROR
                bool "Enable Error Logging"
                default n

            config AWS_OTA_LOG_WARN
                bool "Enable Warning Logging"
                default n

            config AWS_OTA_LOG_INFO
                bool "Enable Info Logging"
                default y

            config AWS_OTA_LOG_DEBUG
                bool "Enable Debug Logging"
                default n

        endmenu # Logging

    endmenu # AWS OTA

endmenu # AWS IoT Library Configurations
```

## examples/fleet_provisioning/fleet_provisioning_with_csr/sdkconfig.defaults
```kconfig
# newlib for ESP32 and ESP8266 platform

CONFIG_NEWLIB_ENABLE=y
CONFIG_NEWLIB_LIBRARY_LEVEL_NORMAL=y
CONFIG_NEWLIB_NANO_FORMAT=
CONFIG_SSL_USING_MBEDTLS=y
CONFIG_LWIP_IPV6=y
CONFIG_MBEDTLS_THREADING_C=y
# CONFIG_MBEDTLS_THREADING_ALT is not set
CONFIG_MBEDTLS_THREADING_PTHREAD=y
CONFIG_PTHREAD_TASK_STACK_SIZE_DEFAULT=8192
CONFIG_ESPTOOLPY_FLASHSIZE_4MB=y
CONFIG_BOOTLOADER_APP_ROLLBACK_ENABLE=y
CONFIG_MBEDTLS_CMAC_C=y
CONFIG_PARTITION_TABLE_CUSTOM=y
CONFIG_PARTITION_TABLE_CUSTOM_FILENAME="partitions.csv"
CONFIG_PARTITION_TABLE_FILENAME="partitions.csv"
CONFIG_MQTT_NETWORK_BUFFER_SIZE=2048
CONFIG_ESP_MAIN_TASK_STACK_SIZE=16384
```

## examples/jobs/sdkconfig.defaults
```kconfig
# newlib for ESP32 and ESP8266 platform

CONFIG_NEWLIB_ENABLE=y
CONFIG_NEWLIB_LIBRARY_LEVEL_NORMAL=y
CONFIG_NEWLIB_NANO_FORMAT=
CONFIG_SSL_USING_MBEDTLS=y
CONFIG_LWIP_IPV6=y
CONFIG_PARTITION_TABLE_CUSTOM=y
CONFIG_PARTITION_TABLE_CUSTOM_FILENAME="partitions.csv"
CONFIG_PARTITION_TABLE_FILENAME="partitions.csv"
```
