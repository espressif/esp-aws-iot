## libraries/ota-for-aws-iot-embedded-sdk/Kconfig
```kconfig
menu "AWS OTA"

    config LOG2_FILE_BLOCK_SIZE
        int "Log base 2 of the size of the file data block message (excluding the header). 10 bits yields a data block size of 1KB."
        default 12
        range 1 4294967295

    config MAX_NUM_BLOCKS_REQUEST
        int "The maximum number of data blocks requested from OTA streaming service."
        default 8
        range 1 4294967295
        help
            This configuration parameter is sent with data requests and represents the maximum number of
            data blocks the service will send in response. The maximum limit for this must be calculated
            from the maximum data response limit (128 KB from service) divided by the block size.
            For example if block size is set as 1 KB then the maximum number of data blocks that we can
            request is 128/1 = 128 blocks. Configure this parameter to this maximum limit or lower based on
            how many data blocks response is expected for each data requests.

    config MAX_NUM_OTA_DATA_BUFFERS
        int "The number of data buffers reserved by the OTA agent."
        default 10
        range 1 4294967295
        help
            This configurations parameter sets the maximum number of static data buffers used by
            the OTA agent for job and file data blocks received.

    config ALLOW_DOWNGRADE
        int "Allow OTA update to same or lower version."
        default 0
        range 0 1
        help
            Set this to 1 to allow downgrade or same version update. This configurations parameter
            disables version check and allows update to a same or lower version. This is provided for
            testing purpose and it is recommended to always update to higher version and keep this
            configuration disabled.

    config OTA_DATA_OVER_MQTT
        bool "Enable data over MQTT"
        default y

    config OTA_DATA_OVER_HTTP
        bool "Enable data over HTTP"
        default n

    choice OTA_PRIMARY_DATA_PROTOCOL
        bool "Primary Data Protocol"
        default OTA_DATA_OVER_MQTT_PRIMARY
        help
            Primary data protocol will be the protocol used for downloading file if more than
            one protocol is selected while creating OTA job.
        config OTA_DATA_OVER_MQTT_PRIMARY
            bool "MQTT"
            depends on OTA_DATA_OVER_MQTT
        config OTA_DATA_OVER_HTTP_PRIMARY
            bool "HTTP"
            depends on OTA_DATA_OVER_HTTP
    endchoice

    config OTA_PRIMARY_DATA_PROTOCOL
        int 
        default 1 if OTA_DATA_OVER_MQTT_PRIMARY
        default 2 if OTA_DATA_OVER_HTTP_PRIMARY

    menu "Logging"

        config AWS_OTA_LOG_ERROR
            bool "Enable Error Logging"
            default y
        
        config AWS_OTA_LOG_WARN
            bool "Enable Warning Logging"
            default y

        config AWS_OTA_LOG_INFO
            bool "Enable Info Logging"
            default y

        config AWS_OTA_LOG_DEBUG
            bool "Enable Debug Logging"
            default n

    endmenu # AWS OTA Logging

endmenu # AWS OTA
```
