## examples/mqtt/tls_mutual_auth/main/Kconfig.projbuild
```kconfig
menu "Example Configuration"

    config MQTT_CLIENT_IDENTIFIER
        string "The MQTT client identifier used in this example"
        default "testClient"
        help
            The MQTT client identifier used in this example. Each client identifier must be unique.
            so edit as required to ensure that no two clients connecting to the same broker use the same client identifier.

    config MQTT_BROKER_ENDPOINT
        string "Endpoint of the MQTT broker to connect to"
        default "test.mosquitto.org"
        help
            This example can be run with any MQTT broker, that supports server authentication.

    config MQTT_BROKER_PORT
        int "Port of the MQTT broker use"
        default 8883
        help
            In general, port 8883 is for secured MQTT connections.
            Port 443 requires use of the ALPN TLS extension with the ALPN protocol name.
            When using port 8883, ALPN is not required.

    config HARDWARE_PLATFORM_NAME
        string "The hardware platform"
        default "ESP32"
        help
            The name of the hardware platform the application is running on.

    config MQTT_NETWORK_BUFFER_SIZE
        int "Size of the network buffer for MQTT packets"
        range 1024 2048
        default 1024
        help
            Size of the network buffer for MQTT packets.

    choice EXAMPLE_CHOOSE_PKI_ACCESS_METHOD
        prompt "Choose PKI credentials access method"
        default EXAMPLE_USE_PLAIN_FLASH_STORAGE
        help
            ESP devices support multiple ways to secure store the PKI credentials.
            Currently Secure Element (ATECC608A) and DS peripheral
            (using ESP Secure Cert Manager) are supported.
            The default behaviour is to access the PKI credentials which are embedded in the binary.
            Consult the ESP-TLS documentation in ESP-IDF Programming guide for more details.

        config EXAMPLE_USE_SECURE_ELEMENT
        bool "Use secure element (ATECC608A)"
        depends on (IDF_TARGET_ESP32 || IDF_TARGET_ESP32C2) && ESP_TLS_USING_MBEDTLS
        select ESP_TLS_USE_SECURE_ELEMENT
        help
            Enable the use of secure element for the example.
            The esp-cryptoauthlib component is required for enabling
            this option.

        config EXAMPLE_USE_ESP_SECURE_CERT_MGR
        bool "Use ESP Secure Certificate Manager"
        help
            Enable the use of ESP Secure Certificate Manager APIs for the example.
            Please refer to ESP Secure Certificate Manager documentation for more details.

        config EXAMPLE_USE_PLAIN_FLASH_STORAGE
        bool "Use flash storage (default)"
        help
            This option expects the Private key and Device certificate to be embedded in the binary.
            This is the default behaviour.
    endchoice

endmenu
```

## examples/ota/ota_http/sdkconfig.defaults
```kconfig
# newlib for ESP32 and ESP8266 platform

CONFIG_NEWLIB_ENABLE=y
CONFIG_NEWLIB_LIBRARY_LEVEL_NORMAL=y
CONFIG_NEWLIB_NANO_FORMAT=
CONFIG_SSL_USING_MBEDTLS=y
CONFIG_LWIP_IPV6=y
CONFIG_MBEDTLS_THREADING_C=y
# CONFIG_MBEDTLS_THREADING_ALT is not set
CONFIG_MBEDTLS_THREADING_PTHREAD=y
CONFIG_PTHREAD_TASK_STACK_SIZE_DEFAULT=8192
CONFIG_PARTITION_TABLE_CUSTOM=y
CONFIG_PARTITION_TABLE_CUSTOM_FILENAME="partitions_ota_http.csv"
CONFIG_PARTITION_TABLE_FILENAME="partitions_ota_http.csv"
CONFIG_ESPTOOLPY_FLASHSIZE_4MB=y
CONFIG_BOOTLOADER_APP_ROLLBACK_ENABLE=y
```

## examples/ota/ota_http/sdkconfig.defaults.esp32s2
```kconfig
# Wi-Fi
CONFIG_ESP32_WIFI_STATIC_RX_BUFFER_NUM=4
CONFIG_ESP32_WIFI_DYNAMIC_RX_BUFFER_NUM=8
CONFIG_ESP32_WIFI_DYNAMIC_TX_BUFFER_NUM=8
CONFIG_ESP32_WIFI_AMPDU_TX_ENABLED=n
CONFIG_ESP32_WIFI_AMPDU_RX_ENABLED=n
CONFIG_ESP32_WIFI_IRAM_OPT=n
CONFIG_ESP32_WIFI_RX_IRAM_OPT=n

# LWIP
CONFIG_LWIP_TCPIP_RECVMBOX_SIZE=16

# mbedTLS
CONFIG_MBEDTLS_SSL_OUT_CONTENT_LEN=2048
CONFIG_MBEDTLS_DYNAMIC_BUFFER=y
CONFIG_MBEDTLS_DYNAMIC_FREE_CONFIG_DATA=y
CONFIG_MBEDTLS_DYNAMIC_FREE_CA_CERT=y
```

## examples/ota/ota_mqtt/main/Kconfig.projbuild
```kconfig
menu "Example Configuration"

config MQTT_CLIENT_IDENTIFIER
    string "The MQTT client identifier used in this example"
	default "testClient"
	help
        The MQTT client identifier used in this example. Each client identifier must be unique.
        so edit as required to ensure that no two clients connecting to the same broker use the same client identifier.

config MQTT_BROKER_ENDPOINT
    string "Endpoint of the MQTT broker to connect to"
    default "test.mosquitto.org"
    help
        This example can be run with any MQTT broker, that supports server authentication.

config MQTT_BROKER_PORT
    int "Port of the MQTT broker use"
    default 8883
    help
        In general, port 8883 is for secured MQTT connections.
        Port 443 requires use of the ALPN TLS extension with the ALPN protocol name.
        When using port 8883, ALPN is not required.

config MQTT_OPTION_SNI
    int "An option to disable Server Name Indication"
    range 0 1
    default 0
    help
        When using a local Mosquitto server setup, SNI needs to be disabled
        for an MQTT broker that only has an IP address but no hostname. However,
        SNI should be enabled whenever possible.

config HARDWARE_PLATFORM_NAME
    string "The hardware platform"
    default "ESP32"
    help
        The name of the hardware platform the application is running on.

config MQTT_EXAMPLE_STACKSIZE
    int "Set the stack size of the example task"
    range 5120 8192
    default 5120
    help
        The actual stack is created by an operating system thread.

config MQTT_NETWORK_BUFFER_SIZE
    int "Size of the network buffer for MQTT packets"
    range 1024 2048
    default 1024
    help
        Size of the network buffer for MQTT packets.

endmenu
```

## examples/thing_shadow/sdkconfig.defaults
```kconfig
# newlib for ESP32 and ESP8266 platform

CONFIG_NEWLIB_ENABLE=y
CONFIG_NEWLIB_LIBRARY_LEVEL_NORMAL=y
CONFIG_NEWLIB_NANO_FORMAT=
CONFIG_SSL_USING_MBEDTLS=y
CONFIG_LWIP_IPV6=y
CONFIG_MBEDTLS_THREADING_C=y
# CONFIG_MBEDTLS_THREADING_ALT is not set
CONFIG_MBEDTLS_THREADING_PTHREAD=y
```

## libraries/Device-Defender-for-AWS-IoT-embedded-sdk/Kconfig
```kconfig
menu "Device Defender"

    config DEFENDER_USE_LONG_KEYS
        bool "Use long key names."
        default n
        help
            AWS IoT Device Defender Service supports both long and short names for keys
            in the report sent by a device.

    menu "Logging"

        config DEVICE_DEFENDER_LOG_ERROR
            bool "Enable Error Logging"
            default n
        
        config DEVICE_DEFENDER_LOG_WARN
            bool "Enable Warning Logging"
            default n

        config DEVICE_DEFENDER_LOG_INFO
            bool "Enable Info Logging"
            default y

        config DEVICE_DEFENDER_LOG_DEBUG
            bool "Enable Debug Logging"
            default n

    endmenu # Logging

endmenu # Device Defender
```

## libraries/Fleet-Provisioning-for-AWS-IoT-embedded-sdk/Kconfig
```kconfig
menu "Fleet Provisioning"

    menu "Logging"

        config FLEET_PROVISIONING_LOG_ERROR
            bool "Enable Error Logging"
            default y
        
        config FLEET_PROVISIONING_LOG_WARN
            bool "Enable Warning Logging"
            default n

        config FLEET_PROVISIONING_LOG_INFO
            bool "Enable Info Logging"
            default y

        config FLEET_PROVISIONING_LOG_DEBUG
            bool "Enable Debug Logging"
            default n

    endmenu # Fleet Provisioning Logging

endmenu # Fleet Provisioning
```

## libraries/coreMQTT-Agent/Kconfig
```kconfig
menu "coreMQTT-Agent"
    
    config MQTT_AGENT_MAX_OUTSTANDING_ACKS
        int "Max Pending ACKS Per Connection"
        default 10
        help
            This can be set to any positive integer up to SIZE_MAX.
            The maximum number of pending acknowledgments to track for a single connection.
            The MQTT agent tracks MQTT commands (such as PUBLISH and SUBSCRIBE) that are still 
            waiting to be acknowledged. MQTT_AGENT_MAX_OUTSTANDING_ACKS set the maximum number 
            of acknowledgments that can be outstanding at any one time. The higher this number 
            is the greater the agent's RAM consumption will be.

    config MQTT_AGENT_MAX_EVENT_QUEUE_WAIT_TIME
        int "Max Event Queue Wait Time Milliseconds"
        default 1000
        range 0 4294967295
        help
            Time in milliseconds that the MQTT agent task will wait in the Blocked state 
            (so not using any CPU time) for a command to arrive in its command queue before 
            exiting the blocked state so it can call MQTT_ProcessLoop().
            It is important that MQTT_ProcessLoop() is called often if there is known MQTT 
            traffic, but calling it too often can take processing time away from lower priority 
            tasks and waste CPU time and power.

endmenu # coreMQTT-Agent
```

## libraries/coreMQTT/Kconfig
```kconfig
menu "coreMQTT"

    config MQTT_STATE_ARRAY_MAX_COUNT
        int "Max Incoming/Outgoing Publish Messages Pending ACK"
        default 10
        range 0 4294967295
        help
            Determines the maximum number of MQTT PUBLISH messages, pending
            acknowledgment at a time, that are supported for incoming and outgoing
            direction of messages, separately.

            QoS 1 and 2 MQTT PUBLISHes require acknowledgment from the server before
            they can be completed. While they are awaiting the acknowledgment, the
            client must maintain information about their state. The value of this
            macro sets the limit on how many simultaneous PUBLISH states an MQTT
            context maintains, separately, for both incoming and outgoing direction of
            PUBLISHes.

            The MQTT context maintains separate state records for outgoing
            and incoming PUBLISHes, and thus, 2 * MQTT_STATE_ARRAY_MAX_COUNT amount
            of memory is statically allocated for the state records.

    config MQTT_MAX_CONNACK_RECEIVE_RETRY_COUNT
        int "Max CONNACK Retries"
        default 5
        range 0 65535
        help
            The number of retries for receiving CONNACK.

            The MQTT_MAX_CONNACK_RECEIVE_RETRY_COUNT will be used only when the
            timeoutMs parameter of #MQTT_Connect is passed as 0 . The transport
            receive for CONNACK will be retried MQTT_MAX_CONNACK_RECEIVE_RETRY_COUNT
            times before timing out. A value of 0 for this config will cause the
            transport receive for CONNACK  to be invoked only once.

    config MQTT_PINGRESP_TIMEOUT_MS
        int "Ping Response Timeout Milliseconds"
        default 5000
        help
            This can be any positive integer up to SIZE_MAX.

            Maximum number of milliseconds to wait for a ping response to a ping
            request as part of the keep-alive mechanism.
            
            If a ping response is not received before this timeout, then
            MQTT_ProcessLoop function will return MQTTKeepAliveTimeout.
            
            If this value is more than half of the keep alive interval, and the
            server does not receive the previous ping request, then it is likely that the
            server will disconnect the client before #MQTTKeepAliveTimeout can be returned.
            
            If a dummy implementation of the MQTTGetCurrentTimeFunc_t timer function,
            is supplied to the library, then the keep-alive mechanism is not supported by the
            MQTT_ProcessLoop API function. In that case, the value of MQTT_PINGRESP_TIMEOUT_MS
            is irrelevant to the behavior of the library.

    config MQTT_RECV_POLLING_TIMEOUT_MS
        int "MQTT Packet Receive Polling Timeout"
        default 10
        range 0 4294967295
        help
            The maximum duration between non-empty network reads while
            receiving an MQTT packet via the MQTT_ProcessLoop or MQTT_ReceiveLoop
            API functions.
            
            When an incoming MQTT packet is detected, the transport receive function
            may be called multiple times until all of the expected number of bytes of the
            packet are received. This timeout represents the maximum polling duration that
            is allowed without any data reception from the network for the incoming packet.
            
            If the timeout expires, the MQTT_ProcessLoop and MQTT_ReceiveLoop functions
            return MQTTRecvFailed.
            
            If a dummy implementation of the MQTTGetCurrentTimeFunc_t timer function,
            is supplied to the library, then MQTT_RECV_POLLING_TIMEOUT_MS MUST be set to 0.

    config MQTT_SEND_TIMEOUT_MS
        int "MQTT Send Timeout Milliseconds"
        default 20000
        range 0 4294967295
        help
            The maximum duration allowed to send an MQTT packet over the transport
            interface.

            When sending an MQTT packet, the transport send or writev functions may be
            called multiple times until all of the required number of bytes are sent.
            This timeout represents the maximum duration that is allowed to send the MQTT
            packet while calling the transport send or writev functions.

            If the timeout expires, #MQTTSendFailed will be returned by the public API
            functions.

            If a dummy implementation of the #MQTTGetCurrentTimeFunc_t timer function,
            is supplied to the library, then #MQTT_SEND_TIMEOUT_MS MUST be set to 0.

    menu "Logging"

        config CORE_MQTT_LOG_ERROR
            bool "Enable Error Logging"
            default y
        
        config CORE_MQTT_LOG_WARN
            bool "Enable Warning Logging"
            default n

        config CORE_MQTT_LOG_INFO
            bool "Enable Info Logging"
            default y

        config CORE_MQTT_LOG_DEBUG
            bool "Enable Debug Logging"
            default n

    endmenu # coreMQTT Logging

endmenu # coreMQTT
```

## libraries/corePKCS11/Kconfig
```kconfig
menu "corePKCS11"

    menu "Logging"

        config CORE_PKCS_LOG_ERROR
            bool "Enable Error Logging"
            default y
        
        config CORE_PKCS_LOG_WARN
            bool "Enable Warning Logging"
            default n

        config CORE_PKCS_LOG_INFO
            bool "Enable Info Logging"
            default y

        config CORE_PKCS_LOG_DEBUG
            bool "Enable Debug Logging"
            default n

    endmenu # Logging

endmenu # corePKCS11
```
