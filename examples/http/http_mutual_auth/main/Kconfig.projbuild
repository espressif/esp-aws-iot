## examples/http/http_mutual_auth/main/Kconfig.projbuild
```kconfig
menu "Example Configuration"

    config AWS_IOT_ENDPOINT
        string "AWS IoT Core endpoint to connect to"

    config AWS_HTTPS_PORT
        int "AWS IoT Core server port number for HTTPS connections"
        default 8443
        help
            Port 443 requires use of the ALPN TLS extension with the ALPN protocol name.
            When using port 8443, ALPN is not required.

    config HARDWARE_PLATFORM_NAME
        string "The hardware platform"
        default "ESP32"
        help
            The name of the hardware platform the application is running on.

    choice EXAMPLE_CHOOSE_PKI_ACCESS_METHOD
        prompt "Choose PKI credentials access method"
        default EXAMPLE_USE_PLAIN_FLASH_STORAGE
        help
            ESP devices support multiple ways to secure store the PKI credentials.
            Currently Secure Element (ATECC608A) and DS peripheral
            (using ESP Secure Cert Manager) are supported.
            The default behaviour is to access the PKI credentials which are embedded in the binary.
            Consult the ESP-TLS documentation in ESP-IDF Programming guide for more details.

        config EXAMPLE_USE_SECURE_ELEMENT
        bool "Use secure element (ATECC608A)"
        depends on ESP_TLS_USING_MBEDTLS
        # At most one of the two symbols below exists per ESP-IDF version;
        # selecting an undefined one is ignored with a Kconfig warning.
        # ESP-IDF < 6.0: mbedTLS ALT integration via esp-tls.
        select ESP_TLS_USE_SECURE_ELEMENT
        # ESP-IDF 6.x with the unified key interface: PSA Crypto opaque driver.
        select MBEDTLS_SECURE_ELEMENT_DRIVER_ENABLED
        help
            Enable the use of ATECC608A secure element for the example.
            On ESP-IDF 6.x this uses the PSA Crypto opaque driver interface
            (unified key interface) via esp-cryptoauthlib; on ESP-IDF < 6.0
            it uses the mbedTLS ALT integration in esp-tls. In both cases the
            private key remains on the secure element and is never exposed.
            On ESP-IDF 6.x the unified key interface (esp_key_config.h) is
            required: available on master (v6.2) and on release/v6.0 (after
            v6.0.2) and release/v6.1. Older 6.x checkouts fail with a
            compile-time error.

        config EXAMPLE_USE_ESP_SECURE_CERT_MGR
        bool "Use ESP Secure Certificate Manager"
        help
            Enable the use of ESP Secure Certificate Manager APIs for the example.
            Please refer to ESP Secure Certificate Manager documentation for more details.

        config EXAMPLE_USE_PLAIN_FLASH_STORAGE
        bool "Use flash storage (default)"
        help
            This option expects the Private key and Device certificate to be embedded in the binary.
            This is the default behaviour.
    endchoice
endmenu
```

## examples/thing_shadow/main/Kconfig.projbuild
```kconfig
menu "Example Configuration"

    config MQTT_CLIENT_IDENTIFIER
        string "The MQTT client identifier used in this example. Also used as Thing Name"
        default "testClient"
        help
            The MQTT client identifier used in this example. Each client identifier must be unique.
            so edit as required to ensure that no two clients connecting to the same broker use the same client identifier.

    config MQTT_BROKER_ENDPOINT
        string "Endpoint of the MQTT broker to connect to"
        default "test.mosquitto.org"
        help
            This example can be run with any MQTT broker, that supports server authentication.

    config MQTT_BROKER_PORT
        int "Port of the MQTT broker use"
        default 8883
        help
            In general, port 8883 is for secured MQTT connections.
            Port 443 requires use of the ALPN TLS extension with the ALPN protocol name.
            When using port 8883, ALPN is not required.

    config HARDWARE_PLATFORM_NAME
        string "The hardware platform"
        default "ESP32"
        help
            The name of the hardware platform the application is running on.

    config MQTT_NETWORK_BUFFER_SIZE
        int "Size of the network buffer for MQTT packets"
        range 1024 2048
        default 1024
        help
            Size of the network buffer for MQTT packets.

    choice EXAMPLE_CHOOSE_PKI_ACCESS_METHOD
        prompt "Choose PKI credentials access method"
        default EXAMPLE_USE_PLAIN_FLASH_STORAGE
        help
            ESP devices support multiple ways to secure store the PKI credentials.
            Currently Secure Element (ATECC608A) and DS peripheral
            (using ESP Secure Cert Manager) are supported.
            The default behaviour is to access the PKI credentials which are embedded in the binary.
            Consult the ESP-TLS documentation in ESP-IDF Programming guide for more details.

        config EXAMPLE_USE_SECURE_ELEMENT
        bool "Use secure element (ATECC608A)"
        depends on ESP_TLS_USING_MBEDTLS
        # At most one of the two symbols below exists per ESP-IDF version;
        # selecting an undefined one is ignored with a Kconfig warning.
        # ESP-IDF < 6.0: mbedTLS ALT integration via esp-tls.
        select ESP_TLS_USE_SECURE_ELEMENT
        # ESP-IDF 6.x with the unified key interface: PSA Crypto opaque driver.
        select MBEDTLS_SECURE_ELEMENT_DRIVER_ENABLED
        help
            Enable the use of ATECC608A secure element for the example.
            On ESP-IDF 6.x this uses the PSA Crypto opaque driver interface
            (unified key interface) via esp-cryptoauthlib; on ESP-IDF < 6.0
            it uses the mbedTLS ALT integration in esp-tls. In both cases the
            private key remains on the secure element and is never exposed.
            On ESP-IDF 6.x the unified key interface (esp_key_config.h) is
            required: available on master (v6.2) and on release/v6.0 (after
            v6.0.2) and release/v6.1. Older 6.x checkouts fail with a
            compile-time error.

        config EXAMPLE_USE_ESP_SECURE_CERT_MGR
        bool "Use ESP Secure Certificate Manager"
        help
            Enable the use of ESP Secure Certificate Manager APIs for the example.
            Please refer to ESP Secure Certificate Manager documentation for more details.

        config EXAMPLE_USE_PLAIN_FLASH_STORAGE
        bool "Use flash storage (default)"
        help
            This option expects the Private key and Device certificate to be embedded in the binary.
            This is the default behaviour.
    endchoice

endmenu
```

## libraries/coreHTTP/Kconfig
```kconfig
menu "coreHTTP"

    menu "Logging"

        config CORE_HTTP_LOG_ERROR
            bool "Enable Error Logging"
            default y
        
        config CORE_HTTP_LOG_WARN
            bool "Enable Warning Logging"
            default n

        config CORE_HTTP_LOG_INFO
            bool "Enable Info Logging"
            default y

        config CORE_HTTP_LOG_DEBUG
            bool "Enable Debug Logging"
            default n

    endmenu # coreHTTP Logging

endmenu # coreHTTP
```
